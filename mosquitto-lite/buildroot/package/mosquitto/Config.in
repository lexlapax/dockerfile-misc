## mosquitto-lite/buildroot/package/mosquitto/Config.in
```kconfig
config BR2_PACKAGE_MOSQUITTO
	bool "mosquitto"
	depends on BR2_PACKAGE_OPENSSL
	help
	  Mosquitto is an open source implementation of a server for version 3.1 of the
          MQTT protocol.
	  Mosquitto project information is available at the following locations:
	  http://mosquitto.org/ (main homepage)
comment "depends on openssl"
	depends on !BR2_PACKAGE_OPENSSL
```

## tiny-haproxy/buildroot/package/haproxy/Config.in
```kconfig
config BR2_PACKAGE_HAPROXY
	bool "haproxy"
	select BR2_PACKAGE_PCRE
	help
	  The Reliable, High Performance TCP/HTTP Load Balancer
	  http://haproxy.1wt.eu/
```

## tiny-mosquitto/buildroot/package/mosquitto/Config.in
```kconfig
config BR2_PACKAGE_MOSQUITTO
	bool "mosquitto"
	select BR2_PACKAGE_OPENSSL
	help
	  Mosquitto is an open source implementation of a server for version 3.1 of the
          MQTT protocol.
	  Mosquitto project information is available at the following locations:
	  http://mosquitto.org/ (main homepage)
```
